## app/boards/shields/styggnus/Kconfig.shield
```kconfig
config SHIELD_STYGGNUS_DONGLE
    def_bool $(shields_list_contains,styggnus_dongle)
    
config SHIELD_STYGGNUS_LEFT
    def_bool $(shields_list_contains,styggnus_left)

config SHIELD_STYGGNUS_RIGHT
    def_bool $(shields_list_contains,styggnus_right)
```

## app/dts/bindings/behaviors/zmk,behavior-murtum-macro.yaml
```yaml
# Copyright (c) 2021 The ZMK Contributors
# SPDX-License-Identifier: MIT

description: MurtuM Macro Behavior

compatible: "zmk,behavior-murtum-macro"

include: one_param.yaml

properties:
  usage-pages:
    type: array
    required: true
```
